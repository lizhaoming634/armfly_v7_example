## CMakeLists.txt
```
cmake_minimum_required(VERSION 3.20.0)

find_package(Zephyr REQUIRED HINTS $ENV{ZEPHYR_BASE})
project(01_helloworld)

target_sources(app PRIVATE src/main.c)
```

## prj.conf
```kconfig
CONFIG_GPIO=y
CONFIG_MEMC=y
CONFIG_MEMC_STM32=y
```

## src/main.c
```c
/*
 * Copyright (c) 2012-2014 Wind River Systems, Inc.
 *
 * SPDX-License-Identifier: Apache-2.0
 */

#include <stdio.h>
#include <zephyr/app_version.h>
#include <zephyr/kernel.h>

int main(void)
{
	printf("App version: %s\r\n", APP_VERSION_STRING);
	while (1) {
		printf("Hello World! %s\n", CONFIG_BOARD_TARGET);
		k_sleep(K_SECONDS(1));
	}
	return 0;
}
```
